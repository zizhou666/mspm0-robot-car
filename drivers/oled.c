/*
================================================================================
128x64 OLED 帧缓冲、字体与非阻塞刷新实现模块
================================================================================
【功能简介】
本文件包含 6x8/8x16 字库和启动 LOGO 位图，通过五线 GPIO 软件 SPI 驱动
SSD1306/SH1106 兼容 OLED。所有绘制先写 RAM 帧缓冲，再由分片状态机逐段
发送，避免完整刷屏长期占用主循环或影响编码器控制实时性。

================================================================================
【函数定义】
- oled_delay_ms/oled_spi_delay：复位初始化及软件 SPI 的底层时序延时。
- oled_spi_write_raw/oled_write_stream：发送单字节或连续命令/显示数据。
- oled_font_index：把可显示 ASCII 字符映射到字库索引。
- oled_u64_to_ascii/oled_format_float/oled_abs_i16：数字格式和绘图工具函数。
- OLED_GPIO_Init/OLED_Reset/OLED_Init：初始化端口、复位并配置控制器。
- OLED_WriteCommand/OLED_WriteData/OLED_SetPosition：底层命令、数据和页地址。
- OLED_DisplayOn/OLED_InvertDisplay/OLED_ShowStartupLogo：显示开关、反显和 LOGO。
- OLED_ClearBuffer/OLED_Clear/OLED_Fill/OLED_ClearLine：帧缓冲清屏与区域清理。
- OLED_ShowChar6x8/OLED_ShowString6x8：6x8 字符和字符串绘制。
- OLED_ShowChar8x16/OLED_ShowString8x16：8x16 字符和字符串绘制。
- OLED_ShowInt6x8/OLED_ShowFloat6x8：整数和定点小数显示。
- OLED_DrawPixel/OLED_DrawLine：像素和任意直线绘制。
- OLED_DrawFastHLine/OLED_DrawFastVLine：水平/垂直快速直线绘制。
- OLED_DrawRect/OLED_FillRect：矩形轮廓和填充矩形绘制。
- OLED_DrawCircle/OLED_FillCircle：圆形轮廓和填充圆绘制。
- OLED_WrCmd/OLED_WrDat/OLED_Set_Pos/OLED_CLS：旧 OLED 接口兼容封装。
- LCD_Set_Pos/LCD_CLS/LCD_Fill/LCD_clear_L：旧 LCD 页面操作兼容封装。
- LCD_P6x8Char/LCD_P6x8Str/LCD_P8x16Char/LCD_P8x16Str：旧文字接口。
- write_6_8_number/write_6_8_number_f1/write_8_16_number：旧数字接口。
- display_6_8_number/display_6_8_number_pro/display_6_8_string：旧显示接口。
- Draw_Logo：把内置启动 LOGO 复制到帧缓冲。
- ssd1306_width/ssd1306_height：返回显示分辨率。
- ssd1306_begin/ssd1306_command/ssd1306_data：SSD1306 初始化及底层兼容接口。
- ssd1306_clear_display/ssd1306_display：SSD1306 清屏和刷新兼容接口。
- ssd1306_invert_display/ssd1306_dim：反显和对比度接口。
- ssd1306_stop_scroll/ssd1306_start_scroll_right/ssd1306_start_scroll_left：硬件滚动控制。
- ssd1306_draw_pixel/ssd1306_draw_line：SSD1306 像素和任意直线兼容接口。
- ssd1306_draw_fast_hline/ssd1306_draw_fast_vline：快速水平/垂直线接口。
- ssd1306_draw_fast_hline_internal/ssd1306_draw_fast_vline_internal：内部快速线转发。
- ssd1306_draw_rect/ssd1306_fill_rect/ssd1306_fill_screen：矩形和整屏填充接口。
- ssd1306_draw_circle/ssd1306_fill_circle：圆形轮廓和填充接口。
- ssd1306_draw_triangle/ssd1306_draw_bitmap：三角形和位图绘制接口。
- OLED_RequestRefresh：置位刷新请求，不等待传输完成。
- OLED_IsBusy：查询是否存在活动或排队的刷新。
- OLED_Process：每次最多发送指定字节数并推进页/列状态。
- OLED_RefreshBlocking/OLED_Refresh：阻塞式整屏刷新兼容接口。
- draw_oled：旧 UI 使用的一次刷新请求封装。

================================================================================
【使用说明】
1. 页面绘制后调用 OLED_RequestRefresh，主循环频繁调用 OLED_Process。
2. OLED_Process 每次发送量由 user_config.h 控制；不要在 ISR 中调用。
3. 字库和 LOGO 数组是只读显示资源，修改时必须保持尺寸和索引范围一致。
4. 显示偏移、扫描方向、亮度和软件 SPI 延时集中在 user_config.h。
================================================================================
*/
#include "oled.h"

#include <stddef.h>
#include <string.h>

#include "startup_cat.h"

/*
 * Ported from the user-provided NController v5 OLED sources.
 * Original source notice: Copyright (C) 2019-2030
 * Wuhan Nameless Innovation Technology Co., Ltd. All rights reserved.
 */

#define OLED_CMD_DISPLAY_OFF (0xAEU)
#define OLED_CMD_DISPLAY_ON (0xAFU)
#define OLED_CMD_NORMAL_DISPLAY (0xA6U)
#define OLED_CMD_INVERT_DISPLAY (0xA7U)
#define OLED_CMD_SET_CONTRAST (0x81U)

#define OLED_SCL_HIGH() DL_GPIO_setPins(OLED_SCL_PORT, OLED_SCL_PIN)
#define OLED_SCL_LOW() DL_GPIO_clearPins(OLED_SCL_PORT, OLED_SCL_PIN)
#define OLED_SDA_HIGH() DL_GPIO_setPins(OLED_SDA_PORT, OLED_SDA_PIN)
#define OLED_SDA_LOW() DL_GPIO_clearPins(OLED_SDA_PORT, OLED_SDA_PIN)
#define OLED_RST_HIGH() DL_GPIO_setPins(OLED_RST_PORT, OLED_RST_PIN)
#define OLED_RST_LOW() DL_GPIO_clearPins(OLED_RST_PORT, OLED_RST_PIN)
#define OLED_DC_HIGH() DL_GPIO_setPins(OLED_DC_PORT, OLED_DC_PIN)
#define OLED_DC_LOW() DL_GPIO_clearPins(OLED_DC_PORT, OLED_DC_PIN)
#define OLED_CS_HIGH() DL_GPIO_setPins(OLED_CS_PORT, OLED_CS_PIN)
#define OLED_CS_LOW() DL_GPIO_clearPins(OLED_CS_PORT, OLED_CS_PIN)

static uint8_t oled_buffer[OLED_WIDTH * OLED_PAGE_COUNT];
static volatile uint8_t oled_refresh_requested = 0U;
static uint8_t oled_refresh_active = 0U;
static uint8_t oled_refresh_page = 0U;
static uint8_t oled_refresh_column = 0U;

static const uint8_t oled_font6x8[95][6] = {
    {0x00, 0x00, 0x00, 0x00, 0x00, 0x00},
    {0x00, 0x00, 0x00, 0x2f, 0x00, 0x00},
    {0x00, 0x00, 0x07, 0x00, 0x07, 0x00},
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    {0x00, 0x02, 0x01, 0x02, 0x04, 0x02},
};

static const uint8_t oled_font8x16[95U * 16U] = {
    0x00,
    0x00,
    0x00,
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    0x00,
};

static const uint8_t oled_startup_logo[OLED_WIDTH * OLED_PAGE_COUNT] = {
    0x00,
    0x00,
    0x00,
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    0x00,
};

static void oled_delay_ms(uint32_t milliseconds)
{
    while (milliseconds > 0U)
    {
        delay_cycles((uint32_t)(OLED_CPU_CLOCK_HZ / 1000U));
        milliseconds--;
    }
}

static void oled_spi_delay(void)
{
#if OLED_SPI_DELAY_CYCLES > 0
    delay_cycles((uint32_t)OLED_SPI_DELAY_CYCLES);
#endif
}

static void oled_spi_write_raw(uint8_t value)
{
    uint8_t bit;

    for (bit = 0U; bit < 8U; bit++)
    {
        OLED_SCL_LOW();
        if ((value & 0x80U) != 0U)
        {
            OLED_SDA_HIGH();
        }
        else
        {
            OLED_SDA_LOW();
        }
        oled_spi_delay();
        OLED_SCL_HIGH();
        oled_spi_delay();
        value <<= 1U;
    }
}

static void oled_write_stream(const uint8_t *data, uint16_t length, uint8_t is_data)
{
    uint16_t index;

    if ((data == NULL) || (length == 0U))
    {
        return;
    }

    if (is_data != 0U)
    {
        OLED_DC_HIGH();
    }
    else
    {
        OLED_DC_LOW();
    }

    OLED_CS_LOW();
    for (index = 0U; index < length; index++)
    {
        oled_spi_write_raw(data[index]);
    }
    OLED_CS_HIGH();
}

static uint8_t oled_font_index(char character)
{
    uint8_t value = (uint8_t)character;

    if ((value < 32U) || (value > 126U))
    {
        value = (uint8_t)'?';
    }
    return (uint8_t)(value - 32U);
}

static uint8_t oled_u64_to_ascii(uint64_t value, char *output)
{
    char reverse[21];
    uint8_t count = 0U;
    uint8_t index;

    do
    {
        reverse[count] = (char)('0' + (char)(value % 10U));
        value /= 10U;
        count++;
    } while ((value != 0U) && (count < (uint8_t)sizeof(reverse)));

    for (index = 0U; index < count; index++)
    {
        output[index] = reverse[(uint8_t)(count - index - 1U)];
    }
    return count;
}

static void oled_format_float(char *output, float value, uint8_t decimals, uint8_t trim_zeros)
{
    static const uint32_t powers_of_ten[] = {
        1U, 10U, 100U, 1000U, 10000U, 100000U, 1000000U};
    uint8_t position = 0U;
    uint8_t index;
    uint32_t scale;
    uint32_t divisor;
    uint64_t scaled;
    uint64_t whole;
    uint32_t fraction;
    float magnitude;

    if (value != value)
    {
        output[0] = 'n';
        output[1] = 'a';
        output[2] = 'n';
        output[3] = 0;
        return;
    }

    if ((value > 999999999.0f) || (value < -999999999.0f))
    {
        output[0] = 'o';
        output[1] = 'v';
        output[2] = 'f';
        output[3] = 0;
        return;
    }

    if (decimals > 6U)
    {
        decimals = 6U;
    }

    if (value < 0.0f)
    {
        output[position] = '-';
        position++;
        magnitude = -value;
    }
    else
    {
        magnitude = value;
    }

    scale = powers_of_ten[decimals];
    scaled = (uint64_t)((magnitude * (float)scale) + 0.5f);
    whole = scaled / scale;
    fraction = (uint32_t)(scaled % scale);

    position = (uint8_t)(position + oled_u64_to_ascii(whole, &output[position]));

    if (decimals > 0U)
    {
        output[position] = '.';
        position++;
        divisor = scale / 10U;
        for (index = 0U; index < decimals; index++)
        {
            output[position] = (char)('0' + (char)(fraction / divisor));
            position++;
            fraction %= divisor;
            if (divisor > 1U)
            {
                divisor /= 10U;
            }
        }

        if (trim_zeros != 0U)
        {
            while ((position > 0U) && (output[position - 1U] == '0'))
            {
                position--;
            }
            if ((position > 0U) && (output[position - 1U] == '.'))
            {
                position--;
            }
        }
    }

    output[position] = 0;
}

static int16_t oled_abs_i16(int16_t value)
{
    return (value < 0) ? (int16_t)-value : value;
}

void OLED_GPIO_Init(void)
{
    DL_GPIO_initDigitalOutput(OLED_SCL_IOMUX);
    DL_GPIO_initDigitalOutput(OLED_SDA_IOMUX);
    DL_GPIO_initDigitalOutput(OLED_RST_IOMUX);
    DL_GPIO_initDigitalOutput(OLED_DC_IOMUX);
    DL_GPIO_initDigitalOutput(OLED_CS_IOMUX);

    OLED_SCL_HIGH();
    OLED_SDA_HIGH();
    OLED_RST_HIGH();
    OLED_DC_LOW();
    OLED_CS_HIGH();

    DL_GPIO_enableOutput(OLED_SCL_PORT, OLED_SCL_PIN);
    DL_GPIO_enableOutput(OLED_SDA_PORT, OLED_SDA_PIN);
    DL_GPIO_enableOutput(OLED_RST_PORT, OLED_RST_PIN);
    DL_GPIO_enableOutput(OLED_DC_PORT, OLED_DC_PIN);
    DL_GPIO_enableOutput(OLED_CS_PORT, OLED_CS_PIN);
}

void OLED_Reset(void)
{
    OLED_CS_HIGH();
    OLED_RST_LOW();
    oled_delay_ms(20U);
    OLED_RST_HIGH();
    oled_delay_ms(20U);
}

void OLED_WriteCommand(uint8_t command)
{
    oled_write_stream(&command, 1U, 0U);
}

void OLED_WriteData(uint8_t data)
{
    oled_write_stream(&data, 1U, 1U);
}

void OLED_SetPosition(uint8_t x, uint8_t page)
{
    uint8_t commands[3];
    uint16_t column;

    if ((x >= OLED_WIDTH) || (page >= OLED_PAGE_COUNT))
    {
        return;
    }

    column = (uint16_t)x + (uint16_t)OLED_COLUMN_OFFSET;
    commands[0] = (uint8_t)(0xB0U | page);
    commands[1] = (uint8_t)(0x10U | ((column >> 4U) & 0x0FU));
    commands[2] = (uint8_t)(column & 0x0FU);
    oled_write_stream(commands, 3U, 0U);
}

void OLED_Init(void)
{
    static const uint8_t init_sequence[] = {
        0xAEU,
        0xD5U, 0x80U,
        0xA8U, 0x3FU,
        0xD3U, 0x00U,
        0x40U,
        0x8DU, 0x14U,
        0x20U, 0x02U,
        OLED_SEG_REMAP_COMMAND,
        OLED_COM_SCAN_COMMAND,
        0xDAU, 0x12U,
        0x81U, OLED_CONTRAST,
        0xD9U, 0xF1U,
        0xDBU, 0x40U,
        0xA4U,
        0xA6U,
        0xAFU};

    OLED_GPIO_Init();
    OLED_Reset();
    oled_write_stream(init_sequence, (uint16_t)sizeof(init_sequence), 0U);
    OLED_Clear();
#if OLED_SHOW_STARTUP_LOGO
    Draw_Logo();
#endif
}

void OLED_DisplayOn(uint8_t on)
{
    OLED_WriteCommand((on != 0U) ? OLED_CMD_DISPLAY_ON : OLED_CMD_DISPLAY_OFF);
}

void OLED_InvertDisplay(uint8_t invert)
{
    OLED_WriteCommand((invert != 0U) ? OLED_CMD_INVERT_DISPLAY : OLED_CMD_NORMAL_DISPLAY);
}

void OLED_ShowStartupLogo(void)
{
    OLED_ShowStartupLogoFrame(0U, 0U);
}

void OLED_ShowStartupLogoFrame(uint8_t frame, uint8_t progress_percent)
{
    char progress_text[5];
    int16_t progress_width;

    if (frame >= STARTUP_CAT_FRAME_COUNT)
    {
        frame = (uint8_t)(frame % STARTUP_CAT_FRAME_COUNT);
    }
    if (progress_percent > 100U)
    {
        progress_percent = 100U;
    }

    OLED_ClearBuffer();
    ssd1306_draw_bitmap(
        (int16_t)((OLED_WIDTH - STARTUP_CAT_FRAME_WIDTH) / 2U),
        0,
        g_startup_cat_frames[frame],
        (int16_t)STARTUP_CAT_FRAME_WIDTH,
        (int16_t)STARTUP_CAT_FRAME_HEIGHT,
        OLED_COLOR_WHITE);

    if (progress_percent >= 100U)
    {
        progress_text[0] = '1';
        progress_text[1] = '0';
        progress_text[2] = '0';
        progress_text[3] = '%';
        progress_text[4] = '\0';
    }
    else if (progress_percent >= 10U)
    {
        progress_text[0] = (char)('0' + (progress_percent / 10U));
        progress_text[1] = (char)('0' + (progress_percent % 10U));
        progress_text[2] = '%';
        progress_text[3] = '\0';
    }
    else
    {
        progress_text[0] = (char)('0' + progress_percent);
        progress_text[1] = '%';
        progress_text[2] = '\0';
    }
    progress_width = (int16_t)(((uint16_t)progress_percent * 98U) / 100U);

    OLED_FillRect(0, 56, OLED_WIDTH, 8, OLED_COLOR_BLACK);
    OLED_ShowString6x8(0U, 7U, progress_text);
    OLED_DrawRect(28, 57, 100, 6, OLED_COLOR_WHITE);
    if (progress_width > 0)
    {
        OLED_FillRect(29, 58, progress_width, 4, OLED_COLOR_WHITE);
    }
    OLED_RequestRefresh();
}

void OLED_ClearBuffer(void)
{
    (void)memset(oled_buffer, 0, sizeof(oled_buffer));
}

void OLED_Refresh(void)
{
    OLED_RequestRefresh();
}

void OLED_Clear(void)
{
    OLED_ClearBuffer();
    OLED_Refresh();
}

void OLED_Fill(uint8_t pattern)
{
    (void)memset(oled_buffer, pattern, sizeof(oled_buffer));
    OLED_Refresh();
}

void OLED_ClearLine(uint8_t x, uint8_t page)
{
    if ((x >= OLED_WIDTH) || (page >= OLED_PAGE_COUNT))
    {
        return;
    }

    (void)memset(&oled_buffer[((uint16_t)page * OLED_WIDTH) + x],
                 0, (size_t)(OLED_WIDTH - x));
}

void OLED_ShowChar6x8(uint8_t x, uint8_t page, char character)
{
    uint8_t index;

    if (x > (OLED_WIDTH - 6U))
    {
        x = 0U;
        page++;
    }
    if (page >= OLED_PAGE_COUNT)
    {
        return;
    }

    index = oled_font_index(character);
    (void)memcpy(&oled_buffer[((uint16_t)page * OLED_WIDTH) + x],
                 oled_font6x8[index], 6U);
}

void OLED_ShowString6x8(uint8_t x, uint8_t page, const char *text)
{
    if (text == NULL)
    {
        return;
    }

    while ((*text != 0) && (page < OLED_PAGE_COUNT))
    {
        if (*text == '\n')
        {
            x = 0U;
            page++;
            text++;
            continue;
        }
        if (x > (OLED_WIDTH - 6U))
        {
            x = 0U;
            page++;
            if (page >= OLED_PAGE_COUNT)
            {
                break;
            }
        }
        OLED_ShowChar6x8(x, page, *text);
        x = (uint8_t)(x + 6U);
        text++;
    }
}

void OLED_ShowChar8x16(uint8_t x, uint8_t page, char character)
{
    uint8_t index;
    const uint8_t *glyph;

    if (x > (OLED_WIDTH - 8U))
    {
        x = 0U;
        page = (uint8_t)(page + 2U);
    }
    if (page > (OLED_PAGE_COUNT - 2U))
    {
        return;
    }

    index = oled_font_index(character);
    glyph = &oled_font8x16[(uint16_t)index * 16U];
    (void)memcpy(&oled_buffer[((uint16_t)page * OLED_WIDTH) + x], glyph, 8U);
    (void)memcpy(&oled_buffer[((uint16_t)(page + 1U) * OLED_WIDTH) + x],
                 &glyph[8], 8U);
}

void OLED_ShowString8x16(uint8_t x, uint8_t page, const char *text)
{
    if (text == NULL)
    {
        return;
    }

    while ((*text != 0) && (page <= (OLED_PAGE_COUNT - 2U)))
    {
        if (*text == '\n')
        {
            x = 0U;
            page = (uint8_t)(page + 2U);
            text++;
            continue;
        }
        if (x > (OLED_WIDTH - 8U))
        {
            x = 0U;
            page = (uint8_t)(page + 2U);
            if (page > (OLED_PAGE_COUNT - 2U))
            {
                break;
            }
        }
        OLED_ShowChar8x16(x, page, *text);
        x = (uint8_t)(x + 8U);
        text++;
    }
}

void OLED_ShowInt6x8(uint8_t x, uint8_t page, int32_t value)
{
    char text[16];
    uint8_t position = 0U;
    uint32_t magnitude;

    if (value < 0)
    {
        text[position] = '-';
        position++;
        magnitude = (uint32_t)(-(value + 1)) + 1U;
    }
    else
    {
        magnitude = (uint32_t)value;
    }

    position = (uint8_t)(position + oled_u64_to_ascii(magnitude, &text[position]));
    text[position] = 0;
    OLED_ShowString6x8(x, page, text);
}

void OLED_ShowFloat6x8(uint8_t x, uint8_t page, float value, uint8_t decimals)
{
    char text[32];

    oled_format_float(text, value, decimals, 0U);
    OLED_ShowString6x8(x, page, text);
}

void OLED_DrawPixel(int16_t x, int16_t y, uint8_t color)
{
    uint16_t index;
    uint8_t mask;

    if ((x < 0) || (x >= (int16_t)OLED_WIDTH) ||
        (y < 0) || (y >= (int16_t)OLED_HEIGHT))
    {
        return;
    }

    index = (uint16_t)x + ((uint16_t)(y >> 3) * OLED_WIDTH);
    mask = (uint8_t)(1U << ((uint8_t)y & 7U));

    if (color == OLED_COLOR_WHITE)
    {
        oled_buffer[index] |= mask;
    }
    else if (color == OLED_COLOR_BLACK)
    {
        oled_buffer[index] &= (uint8_t)~mask;
    }
    else
    {
        oled_buffer[index] ^= mask;
    }
}

void OLED_DrawLine(int16_t x0, int16_t y0, int16_t x1, int16_t y1, uint8_t color)
{
    int16_t dx = oled_abs_i16((int16_t)(x1 - x0));
    int16_t sx = (x0 < x1) ? 1 : -1;
    int16_t dy = (int16_t)-oled_abs_i16((int16_t)(y1 - y0));
    int16_t sy = (y0 < y1) ? 1 : -1;
    int16_t error = (int16_t)(dx + dy);

    for (;;)
    {
        OLED_DrawPixel(x0, y0, color);
        if ((x0 == x1) && (y0 == y1))
        {
            break;
        }

        {
            int16_t error2 = (int16_t)(2 * error);
            if (error2 >= dy)
            {
                error = (int16_t)(error + dy);
                x0 = (int16_t)(x0 + sx);
            }
            if (error2 <= dx)
            {
                error = (int16_t)(error + dx);
                y0 = (int16_t)(y0 + sy);
            }
        }
    }
}

void OLED_DrawFastHLine(int16_t x, int16_t y, int16_t width, uint8_t color)
{
    int16_t index;

    if (width <= 0)
    {
        return;
    }
    for (index = 0; index < width; index++)
    {
        OLED_DrawPixel((int16_t)(x + index), y, color);
    }
}

void OLED_DrawFastVLine(int16_t x, int16_t y, int16_t height, uint8_t color)
{
    int16_t index;

    if (height <= 0)
    {
        return;
    }
    for (index = 0; index < height; index++)
    {
        OLED_DrawPixel(x, (int16_t)(y + index), color);
    }
}

void OLED_DrawRect(int16_t x, int16_t y, int16_t width, int16_t height, uint8_t color)
{
    if ((width <= 0) || (height <= 0))
    {
        return;
    }

    OLED_DrawFastHLine(x, y, width, color);
    OLED_DrawFastHLine(x, (int16_t)(y + height - 1), width, color);
    OLED_DrawFastVLine(x, y, height, color);
    OLED_DrawFastVLine((int16_t)(x + width - 1), y, height, color);
}

void OLED_FillRect(int16_t x, int16_t y, int16_t width, int16_t height, uint8_t color)
{
    int16_t column;

    if ((width <= 0) || (height <= 0))
    {
        return;
    }

    for (column = 0; column < width; column++)
    {
        OLED_DrawFastVLine((int16_t)(x + column), y, height, color);
    }
}

void OLED_DrawCircle(int16_t x0, int16_t y0, int16_t radius, uint8_t color)
{
    int16_t x;
    int16_t y;
    int16_t decision;

    if (radius < 0)
    {
        return;
    }

    x = radius;
    y = 0;
    decision = (int16_t)(1 - radius);

    while (x >= y)
    {
        OLED_DrawPixel((int16_t)(x0 + x), (int16_t)(y0 + y), color);
        OLED_DrawPixel((int16_t)(x0 + y), (int16_t)(y0 + x), color);
        OLED_DrawPixel((int16_t)(x0 - y), (int16_t)(y0 + x), color);
        OLED_DrawPixel((int16_t)(x0 - x), (int16_t)(y0 + y), color);
        OLED_DrawPixel((int16_t)(x0 - x), (int16_t)(y0 - y), color);
        OLED_DrawPixel((int16_t)(x0 - y), (int16_t)(y0 - x), color);
        OLED_DrawPixel((int16_t)(x0 + y), (int16_t)(y0 - x), color);
        OLED_DrawPixel((int16_t)(x0 + x), (int16_t)(y0 - y), color);

        y++;
        if (decision <= 0)
        {
            decision = (int16_t)(decision + (2 * y) + 1);
        }
        else
        {
            x--;
            decision = (int16_t)(decision + (2 * (y - x)) + 1);
        }
    }
}

void OLED_FillCircle(int16_t x0, int16_t y0, int16_t radius, uint8_t color)
{
    int16_t x;
    int16_t y;
    int32_t limit;

    if (radius < 0)
    {
        return;
    }

    limit = (int32_t)radius * radius;
    for (y = (int16_t)-radius; y <= radius; y++)
    {
        for (x = (int16_t)-radius; x <= radius; x++)
        {
            if ((((int32_t)x * x) + ((int32_t)y * y)) <= limit)
            {
                OLED_DrawPixel((int16_t)(x0 + x), (int16_t)(y0 + y), color);
            }
        }
    }
}

void OLED_WrCmd(unsigned char data)
{
    OLED_WriteCommand((uint8_t)data);
}

void OLED_WrDat(unsigned char data)
{
    OLED_WriteData((uint8_t)data);
}

void OLED_Set_Pos(unsigned char x, unsigned char y)
{
    OLED_SetPosition((uint8_t)x, (uint8_t)y);
}

void OLED_CLS(void)
{
    OLED_Clear();
}

void LCD_Set_Pos(unsigned char x, unsigned char y)
{
    OLED_SetPosition((uint8_t)x, (uint8_t)y);
}

void LCD_CLS(void)
{
    OLED_Clear();
}

void LCD_Fill(unsigned char pattern)
{
    OLED_Fill((uint8_t)pattern);
}

void LCD_clear_L(unsigned char x, unsigned char y)
{
    OLED_ClearLine((uint8_t)x, (uint8_t)y);
}

void LCD_P6x8Char(unsigned char x, unsigned char y, unsigned char ch)
{
    OLED_ShowChar6x8((uint8_t)x, (uint8_t)y, (char)ch);
}

void LCD_P6x8Str(unsigned char x, unsigned char y, unsigned char ch[])
{
    OLED_ShowString6x8((uint8_t)x, (uint8_t)y, (const char *)ch);
}

void LCD_P8x16Char(unsigned char x, unsigned char y, unsigned char ch)
{
    OLED_ShowChar8x16((uint8_t)x, (uint8_t)y, (char)ch);
}

void LCD_P8x16Str(unsigned char x, unsigned char y, unsigned char ch[])
{
    OLED_ShowString8x16((uint8_t)x, (uint8_t)y, (const char *)ch);
}

void write_6_8_number(unsigned char x, unsigned char y, float number)
{
    char text[32];

    oled_format_float(text, number, 3U, 1U);
    OLED_ShowString6x8((uint8_t)x, (uint8_t)y, text);
}

void write_6_8_number_f1(unsigned char x, unsigned char y, float number)
{
    char text[32];

    oled_format_float(text, number, 1U, 0U);
    OLED_ShowString6x8((uint8_t)x, (uint8_t)y, text);
}

void write_8_16_number(unsigned char x, unsigned char y, float number)
{
    char text[32];

    oled_format_float(text, number, 3U, 1U);
    OLED_ShowString8x16((uint8_t)x, (uint8_t)y, text);
}

void display_6_8_number(unsigned char x, unsigned char y, float number)
{
    write_6_8_number(x, y, number);
}

void display_6_8_number_pro(unsigned char x, unsigned char y, float number)
{
    if (number < 0.0f)
    {
        OLED_ShowChar6x8((uint8_t)x, (uint8_t)y, '-');
        number = -number;
    }
    else
    {
        OLED_ShowChar6x8((uint8_t)x, (uint8_t)y, '+');
    }
    write_6_8_number((unsigned char)(x + 6U), y, number);
}

void display_6_8_string(unsigned char x, unsigned char y, char ch[])
{
    OLED_ShowString6x8((uint8_t)x, (uint8_t)y, ch);
}

void Draw_Logo(void)
{
    OLED_ShowStartupLogo();
}

int16_t ssd1306_width(void)
{
    return (int16_t)OLED_WIDTH;
}

int16_t ssd1306_height(void)
{
    return (int16_t)OLED_HEIGHT;
}

void ssd1306_begin(uint8_t vccstate)
{
    (void)vccstate;
    OLED_Init();
}

void ssd1306_command(uint8_t command)
{
    OLED_WriteCommand(command);
}

void ssd1306_data(uint8_t data)
{
    OLED_WriteData(data);
}

void ssd1306_clear_display(void)
{
    OLED_ClearBuffer();
}

void ssd1306_display(void)
{
    OLED_Refresh();
}

void ssd1306_invert_display(uint8_t invert)
{
    OLED_InvertDisplay(invert);
}

void ssd1306_dim(uint8_t dim)
{
    OLED_WriteCommand(OLED_CMD_SET_CONTRAST);
    OLED_WriteCommand((dim != 0U) ? 0x00U : OLED_CONTRAST);
}

void ssd1306_stop_scroll(void)
{
    OLED_WriteCommand(0x2EU);
}

void ssd1306_start_scroll_right(uint8_t start, uint8_t stop)
{
    static const uint8_t prefix[] = {0x26U, 0x00U};
    static const uint8_t suffix[] = {0x00U, 0xFFU, 0x2FU};

    oled_write_stream(prefix, (uint16_t)sizeof(prefix), 0U);
    OLED_WriteCommand(start);
    OLED_WriteCommand(0x00U);
    OLED_WriteCommand(stop);
    oled_write_stream(suffix, (uint16_t)sizeof(suffix), 0U);
}

void ssd1306_start_scroll_left(uint8_t start, uint8_t stop)
{
    static const uint8_t prefix[] = {0x27U, 0x00U};
    static const uint8_t suffix[] = {0x00U, 0xFFU, 0x2FU};

    oled_write_stream(prefix, (uint16_t)sizeof(prefix), 0U);
    OLED_WriteCommand(start);
    OLED_WriteCommand(0x00U);
    OLED_WriteCommand(stop);
    oled_write_stream(suffix, (uint16_t)sizeof(suffix), 0U);
}

void ssd1306_draw_pixel(int16_t x, int16_t y, uint16_t color)
{
    OLED_DrawPixel(x, y, (uint8_t)color);
}

void ssd1306_draw_line(int16_t x0, int16_t y0, int16_t x1, int16_t y1, uint16_t color)
{
    OLED_DrawLine(x0, y0, x1, y1, (uint8_t)color);
}

void ssd1306_draw_fast_hline(int16_t x, int16_t y, int16_t width, uint16_t color)
{
    OLED_DrawFastHLine(x, y, width, (uint8_t)color);
}

void ssd1306_draw_fast_hline_internal(int16_t x, int16_t y, int16_t width, uint16_t color)
{
    OLED_DrawFastHLine(x, y, width, (uint8_t)color);
}

void ssd1306_draw_fast_vline(int16_t x, int16_t y, int16_t height, uint16_t color)
{
    OLED_DrawFastVLine(x, y, height, (uint8_t)color);
}

void ssd1306_draw_fast_vline_internal(int16_t x, int16_t y, int16_t height, uint16_t color)
{
    OLED_DrawFastVLine(x, y, height, (uint8_t)color);
}

void ssd1306_draw_rect(int16_t x, int16_t y, int16_t width, int16_t height, uint16_t color)
{
    OLED_DrawRect(x, y, width, height, (uint8_t)color);
}

void ssd1306_fill_rect(int16_t x, int16_t y, int16_t width, int16_t height, uint16_t color)
{
    OLED_FillRect(x, y, width, height, (uint8_t)color);
}

void ssd1306_fill_screen(uint16_t color)
{
    uint16_t index;

    if (color == OLED_COLOR_BLACK)
    {
        (void)memset(oled_buffer, 0, sizeof(oled_buffer));
    }
    else if (color == OLED_COLOR_WHITE)
    {
        (void)memset(oled_buffer, 0xFF, sizeof(oled_buffer));
    }
    else
    {
        for (index = 0U; index < (uint16_t)sizeof(oled_buffer); index++)
        {
            oled_buffer[index] = (uint8_t)~oled_buffer[index];
        }
    }
}

void ssd1306_draw_circle(int16_t x0, int16_t y0, int16_t radius, uint16_t color)
{
    OLED_DrawCircle(x0, y0, radius, (uint8_t)color);
}

void ssd1306_fill_circle(int16_t x0, int16_t y0, int16_t radius, uint16_t color)
{
    OLED_FillCircle(x0, y0, radius, (uint8_t)color);
}

void ssd1306_draw_triangle(int16_t x0, int16_t y0, int16_t x1, int16_t y1,
                           int16_t x2, int16_t y2, uint16_t color)
{
    OLED_DrawLine(x0, y0, x1, y1, (uint8_t)color);
    OLED_DrawLine(x1, y1, x2, y2, (uint8_t)color);
    OLED_DrawLine(x2, y2, x0, y0, (uint8_t)color);
}

void ssd1306_draw_bitmap(int16_t x, int16_t y, const uint8_t *bitmap,
                         int16_t width, int16_t height, uint16_t color)
{
    int16_t row;
    int16_t column;
    uint8_t byte_value = 0U;

    if ((bitmap == NULL) || (width <= 0) || (height <= 0))
    {
        return;
    }

    for (row = 0; row < height; row++)
    {
        for (column = 0; column < width; column++)
        {
            if ((column & 7) == 0)
            {
                byte_value = bitmap[(row * ((width + 7) / 8)) + (column / 8)];
            }
            else
            {
                byte_value <<= 1U;
            }
            if ((byte_value & 0x80U) != 0U)
            {
                OLED_DrawPixel((int16_t)(x + column), (int16_t)(y + row),
                               (uint8_t)color);
            }
        }
    }
}

void OLED_RequestRefresh(void)
{
    oled_refresh_requested = 1U;
}

uint8_t OLED_IsBusy(void)
{
    return (uint8_t)((oled_refresh_active != 0U) ||
                     (oled_refresh_requested != 0U));
}

void OLED_Process(void)
{
    uint8_t i;
    uint8_t bytes_to_send;
    uint8_t bytes_remaining;
    uint16_t buffer_index;

    if (oled_refresh_active == 0U)
    {
        if (oled_refresh_requested == 0U)
        {
            return;
        }

        oled_refresh_requested = 0U;
        oled_refresh_active = 1U;
        oled_refresh_page = 0U;
        oled_refresh_column = 0U;
    }

    bytes_remaining = (uint8_t)(OLED_WIDTH - oled_refresh_column);
    bytes_to_send = (uint8_t)OLED_SERVICE_BYTES_PER_CALL;

    if (bytes_to_send > bytes_remaining)
    {
        bytes_to_send = bytes_remaining;
    }

    OLED_SetPosition(oled_refresh_column, oled_refresh_page);

    buffer_index = ((uint16_t)oled_refresh_page * OLED_WIDTH) +
                   oled_refresh_column;

    for (i = 0U; i < bytes_to_send; i++)
    {
        OLED_WriteData(oled_buffer[buffer_index + i]);
    }

    oled_refresh_column = (uint8_t)(oled_refresh_column + bytes_to_send);

    if (oled_refresh_column >= OLED_WIDTH)
    {
        oled_refresh_column = 0U;
        oled_refresh_page++;

        if (oled_refresh_page >= OLED_PAGE_COUNT)
        {
            oled_refresh_page = 0U;
            oled_refresh_active = 0U;
        }
    }
}

void OLED_RefreshBlocking(void)
{
    uint8_t page;
    uint8_t column;
    uint16_t buffer_index;

    oled_refresh_requested = 0U;
    oled_refresh_active = 0U;
    oled_refresh_page = 0U;
    oled_refresh_column = 0U;

    for (page = 0U; page < OLED_PAGE_COUNT; page++)
    {
        OLED_SetPosition(0U, page);

        buffer_index = (uint16_t)page * OLED_WIDTH;

        for (column = 0U; column < OLED_WIDTH; column++)
        {
            OLED_WriteData(oled_buffer[buffer_index + column]);
        }
    }
}

void draw_oled(void)
{
    OLED_Refresh();
}
